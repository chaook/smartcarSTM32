#include "lcd.h"
#include "stm32f10x_gpio.h"

#define  Display  0xAF  	//显示开启
#define  Power    0x2F	   //电源全开
#define  VO       0x24     //对比度调节	     
#define  AllPoint 0xA4	   //非全屏显示
#define  ADCset   0xA1    	//负向，131-4
#define  COMset   0xc0    	//com0-com63
#define  ELECTVO  0x81     //亮度调节	 调节颜色 	不同的模块需要不同的  ELECTSET
#define  ELECTSET 0x2a	   //亮度数值	 调节颜色 	不同的模块需要不同的	数值
#define  BIASSET  0xA2    //占空比1/9

/* 鸡 米 花 */
uchar name[] = {
0x00,0x00,0x00,0x00,0x00,0x00,0x00,0x00,0x00,0x00,0x00,0x00,0x00,0x00,0x00,0x00,
0x00,0x00,0x00,0x00,0x00,0x00,0x00,0x00,0x00,0x00,0x00,0x00,0x00,0x00,0x00,0x00,
0x00,0x00,0x00,0x00,0x00,0x00,0x00,0x00,0x00,0x00,0x00,0x00,0x00,0x00,0x00,0x00,
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0x00,0x00,0x00,0x00,0x00,0x00,0x00,0x00,0x00,0x00,0x00,0x00,0x00,0x00,0x00,0x00,
};

void lcd_init()
{
	GPIO_InitTypeDef GPIO_InitStruct;
	
	RCC_APB2PeriphClockCmd(RCC_APB2Periph_GPIOA, ENABLE);
	
	GPIO_InitStruct.GPIO_Mode = GPIO_Mode_Out_PP;
	GPIO_InitStruct.GPIO_Pin = GPIO_Pin_7|GPIO_Pin_6|GPIO_Pin_5|GPIO_Pin_4|GPIO_Pin_3;
	GPIO_InitStruct.GPIO_Speed = GPIO_Speed_10MHz;
	GPIO_Init(GPIOA, &GPIO_InitStruct);
	
	
	GPIO_ResetBits(GPIOA, LCD_CS);
	GPIO_ResetBits(GPIOA, LCD_RST);
	delay(200);
	GPIO_SetBits(GPIOA, LCD_RST);
	delay(1000);	
	  	/*
		write_cmd(BIASSET);	
		write_cmd(ADCset);
		write_cmd(COMset);
    	write_cmd(AllPoint);  
		write_cmd(VO);	  
		write_cmd(ELECTVO);	 
		write_cmd(ELECTSET);   
		write_cmd(Power);	 
		write_cmd(Display);	

			*/
	
		write_cmd(0xe2);//system reset
		delay(200);
		
		write_cmd(0x24);//SET VLCD RESISTOR RATIO
		write_cmd(0xa2);//BR=1/9
		write_cmd(0xa0);//set seg direction
		write_cmd(0xc8);//set com direction
		write_cmd(0x2f);//set power control
		write_cmd(0x40);//set scroll line
		write_cmd(0x81);//SET ELECTRONIC VOLUME
		write_cmd(0x20);//set pm: 通过改变这里的数值来改变电压 
		//write_cmd(0xa6);//set inverse display	   a6 off, a7 on
		//write_cmd(0xa4);//set all pixel on
		write_cmd(0xaf);//set display enable
    LcmClear();
}

void delay(uint ms)
{  uint k;
	 uint j=0;
   for(k=0;k<ms;k++)
		for(j=0;j<8500;j++);
}
/********************
数据移位  最高位存入，
********************/
void SendByte(uchar Dbyte)
{
         uchar i,TEMP; 
				 TEMP=Dbyte;
         for(i=0;i<8;i++)
         {
					 GPIO_ResetBits(GPIOA, LCD_SCK);
				 //  delay(1);
					 if((TEMP&0x80)==0x80)
						 GPIO_SetBits(GPIOA, LCD_SID);
					 else
						 GPIO_ResetBits(GPIOA, LCD_SID);
					 TEMP=TEMP<<1; 
					 GPIO_SetBits(GPIOA, LCD_SCK);
					// delay(1);
         }
}

/****************
写指令
**************/
void write_cmd( uchar Cbyte )
{
	GPIO_ResetBits(GPIOA, LCD_CS);
	GPIO_ResetBits(GPIOA, LCD_A0);
  SendByte(Cbyte);
}

/***************
写数据
******************/
void write_data( uchar Dbyte )
{
	GPIO_ResetBits(GPIOA, LCD_CS);
	GPIO_SetBits(GPIOA, LCD_A0);  
  SendByte(Dbyte);
}

/*************************
8*8字符，取模顺序是列行式，
从上到下，高位在前，从左到右；
先选择页地址0-7，再选择列0-130
页码是直接读取8位数据作为地址；
列是先读取高四位，后读取低四位；
**********************/
void  PUTchar8x8(uchar row,uchar col,uchar count,uchar *put)
{	
	uchar i, j;
	uint X=0;
		write_cmd(0xb0+row);
	  	write_cmd(0x10+(8*col/16));		
		write_cmd(0x00+(8*col%16));
		for(j=0;j<count;j++)
	    for(i=0;i<8;i++) write_data(put[X++]); 	
}


/*****************
8*16字符，取模顺序是列行式，
从上到下，高位在前，从左到右；
先选择页地址0-7，再选择列0-127
页码是直接读取8位数据作为地址；
列是先读取高四位，后读取低四位；
**********************/
void  PUTchar8x16(uchar row,uchar col,uchar count,uchar *put)
{		
	uint X=0;
	uchar i, j;
	write_cmd(0xb0+row);
	write_cmd(0x10+(8*col/16));		
	write_cmd(0x00+(8*col%16));
	for(j=0;j<count;j++)
	{ 
		for(i=0;i<8;i++) 
			write_data(put[X++]);
	  write_cmd(0xb1+row);
		write_cmd(0x10+(8*col/16));
		write_cmd(0x00+(8*col%16));
		for(i=0;i<8;i++) 
			write_data(put[X++]);
	  write_cmd(0xb0+row);
		col=col+1;
	} 
}

void display_name()
{
	uint X=0;
	uchar i, j, k;
	for (k=1; k<4; k++)
	{
		for(j=0;j<8;j++)
		{
			write_cmd(0xb0+j); 
			write_cmd(0x10);		
			write_cmd(0x00);
			for(i=0;i<128;i++) 
				write_data(name[X++]); 	
		}
		delay(1000);
	}
}


/*****************
16*16字符，取模顺序是列行式，
从上到下，高位在前，从左到右；
先选择页地址0-7，再选择列0-127
页码是直接读取8位数据作为地址；
列是先读取高四位，后读取低四位；
**********************/
void PUTchar16x16(uchar row,uchar col,uchar count,uchar *put)
{	
		uint X=0;
		uchar i, j;
		write_cmd(0xb0+row);
	  write_cmd(0x10+(8*col/16));		
		write_cmd(0x00+(8*col%16));
		for(j=0;j<count;j++)
		{ 
			for(i=0;i<16;i++) 
				write_data(put[X++]); 
	  	write_cmd(0xb1+row);	
		  write_cmd(0x10+(8*col/16));		
		  write_cmd(0x00+(8*col%16));
		  for(i=0;i<16;i++) 
				write_data(put[X++]);
	    write_cmd(0xb0+row);	 
		  col=col+2; 
		}
}

/*****************
24*24字符，取模顺序是列行式，
从上到下，高位在前，从左到右；
先选择页地址0-7，再选择列0-127
页码是直接读取8位数据作为地址；
列是先读取高四位，后读取低四位；
**********************/
void  PUTchar24x24(uchar row,uchar col,uchar count,uchar *put)
{		
	uchar i, j;
	uint X=0;
		write_cmd(0xb0+row);
	  	write_cmd(0x10+(8*col/16));		
		write_cmd(0x00+(8*col%16));
		for(j=0;j<count;j++)
		{ for(i=0;i<24;i++) write_data(put[X++]); 
	  	  write_cmd(0xb1+row);	
		  write_cmd(0x10+(8*col/16));		
		  write_cmd(0x00+(8*col%16));
		  for(i=0;i<24;i++) write_data(put[X++]);
	      write_cmd(0xb2+row);	
		  write_cmd(0x10+(8*col/16));		
		  write_cmd(0x00+(8*col%16));
		  for(i=0;i<24;i++) write_data(put[X++]);
		  write_cmd(0xb0+row);
		  col=col+3; }
}

/*****************
图片；取模顺序是列行式，
从上到下，低在前，从左到右；
先选择页地址0-7，再选择列0-127
页码是直接读取8位数据作为地址；
列是先读取高四位，后读取低四位；
**********************/
void  PUTBMP(uchar *put)
{		uint X=0;
	uchar i, j;
		for(j=0;j<8;j++)
		{write_cmd(0xb0+j); 
		 write_cmd(0x10);		
		 write_cmd(0x00);
	     for(i=0;i<128;i++) write_data(put[X++]); }	

}

/*****************
图片反显；取模顺序是列行式，
从上到下，位在前，从左到右；
先选择页地址0-7，再选择列0-127
页码是直接读取8位数据作为地址；
列是先读取高四位，后读取低四位；
**********************/
void  PUTREVERSEBMP(uchar *put)
{		uint X=0;
	uchar i, j;
		for(j=0;j<8;j++)
		{write_cmd(0xb0+j); 
		 write_cmd(0x10);		
		 write_cmd(0x00);
	    for(i=0;i<128;i++) write_data(~put[X++]); }	

}

/*****************
清屏；取模顺序是列行式，
从上到下，低位在前，从左到右；
先选择页地址0-7，再选择列0-127
页码是直接读取8位数据作为地址；
列是先读取高四位，后读取低四位；
**********************/
void LcmClear()
{	 uchar x,y;
	 for(y=0;y<8;y++)
	  {    
		write_cmd(0xb0+y);
	  	write_cmd(0x10);		
		write_cmd(0x00);
        for(x=0;x<132;x++)  write_data(0); }	
}	 
/**************
O横线程序；
************/
void  ohengxian()
{
     uchar x,y;
	 for(y=0;y<8;y++)
	  {    
		write_cmd(0xb0+y);
	  	write_cmd(0x10);		
		write_cmd(0x00);
        for(x=0;x<128;x++) 
	     write_data(0x55); }	 
}

/**************
奇横线程序；
************/
void  jihengxian()
{
     uchar x,y;
	 for(y=0;y<8;y++)
	  {    
		write_cmd(0xb0+y);
	  	write_cmd(0x10);		
		write_cmd(0x00);
        for(x=0;x<128;x++) 
	     write_data(0xAA); }	 
}

/***********************
O竖线程序；
***********************/
void  oshuxian()
{
     uchar x,y;
	 for(y=0;y<8;y++)
	  {    
		write_cmd(0xb0+y);
	  	write_cmd(0x10);		
		write_cmd(0x00);
        for(x=0;x<128;x++) 
	    if(x%2==0)write_data(0xFF);
		else  write_data(0); }	 
} 

/***********************
奇竖线程序；
***********************/
void  jishuxian()
{
     uchar x,y;
	 for(y=0;y<8;y++)
	  {    
		write_cmd(0xb0+y);
	  	write_cmd(0x10);		
		write_cmd(0x00);
        for(x=0;x<128;x++) 
	    if(x%2==0) write_data(0); 
		else write_data(0xFF); }	 
}

/*******************
点显示程序；
************************/
void  dianxian()
{
     uchar x,y;
	 for(y=0;y<8;y++)
	  {    
			write_cmd(0xb0+y);
			write_cmd(0x10);		
			write_cmd(0x00);
			for(x=0;x<128;x++) 
				if(x%2==0) 
					write_data(0xAA); 
				else
					write_data(0x55); 
		}	 
}

uchar charset[][16] = {  

{0x00,0x00,0x00,0x00,0x00,0x00,0x00,0x00,0x00,0x00,0x00,0x00,0x00,0x00,0x00,0x00},/*" ",0*/

{0x00,0x00,0x00,0xF8,0x00,0x00,0x00,0x00,0x00,0x00,0x00,0x33,0x00,0x00,0x00,0x00},/*"!",1*/
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{0x00,0x02,0x01,0x02,0x02,0x04,0x02,0x00,0x00,0x00,0x00,0x00,0x00,0x00,0x00,0x00},/*"~",94*/


};

void  zifu16x16xian()
{ 
	uchar k;
  for(k=0;k<4;k++)
		PUTchar16x16(2*k,0,16,"");
}

void show_8X16char(uchar dat[], uchar row, uchar col)
{
	int i;
	write_cmd(0xb0+row*2); 
	write_cmd(0x10+(8*col/16));		
	write_cmd(0x00+(8*col%16));
	for (i=0; i<16; i++)
	{
		if (i==8)
		{
			write_cmd(0xb0+row*2+1); 
			write_cmd(0x10+(8*col/16));		
			write_cmd(0x00+(8*col%16));
		}
		write_data(dat[i]);
	}
}

void lcd_show_8X16char(uchar dat, uchar row, uchar col)
{
	if (dat>127||dat<32)
		dat = 32;
	show_8X16char(charset[dat-32], row, col);
}

void lcd_show_8X16string(uchar *dat, uchar row, uchar col)
{
	
	while((*dat) != '\0')
	{
		if (*dat>127||*dat<32)
			*dat = 32;
		show_8X16char(charset[(*dat)-32], row, col++);
		dat++;
		if (col>=16)
		{
			row++;
			col = 0;
		}
	}
}



void lcd_test()
{
//	lcd_show_string("ABCDEFGHIJKLMNOPQRSTUVWXYZ", 0, 0);
	
	/*
	lcd_show_8X16char('B', 0, 0);
	lcd_show_8X16char('B', 1, 0);
	lcd_show_8X16char('B', 2, 0);
	lcd_show_8X16char('B', 3, 0);
//	lcd_show_8X16char('B', 0, 1);
//	lcd_show_8X16char('y', 0, 15);
//	lcd_show_8X16char('A', 3, 3);
//	lcd_show_8X16char('8', 2, 3);
	
//	uchar t[] = charset[1];
	lcd_display_16char(charset[1], 0, 0);
	lcd_display_16char(charset[2], 0, 1);
	lcd_display_16char(charset[7], 0, 2);
	lcd_display_16char(charset[8], 0, 3);
	lcd_display_16char(charset[10], 0, 4);
	lcd_display_16char(charset[20], 0, 5);
	lcd_display_16char(charset[15], 0, 6);
}
	*/
}
